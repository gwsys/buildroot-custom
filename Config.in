## Config.in
```kconfig
source "$BR2_EXTERNAL/package/rt2880_app/Config.in"
source "$BR2_EXTERNAL/package/ubus/Config.in"
```

## configs/mt7620_defconfig
```kconfig
BR2_mipsel=y
BR2_mips_32r2=y
BR2_KERNEL_MIRROR="http://www.kernel.org/pub"
BR2_LUAROCKS_MIRROR="http://luarocks.org/repositories/rocks"
BR2_JLEVEL=5
BR2_PACKAGE_OVERRIDE_FILE="$(BR2_EXTERNAL)/board/mt7620/local.mk"
BR2_GLOBAL_PATCH_DIR="$(BR2_EXTERNAL)/patches"
BR2_KERNEL_HEADERS_VERSION=y
BR2_DEFAULT_KERNEL_VERSION="2.6.36.x"
BR2_UCLIBC_CONFIG="$(BR2_EXTERNAL)/board/mt7620/uclibc.config"
BR2_TOOLCHAIN_BUILDROOT_INET_RPC=y
BR2_GCC_VERSION_4_7_X=y
BR2_TOOLCHAIN_BUILDROOT_CXX=y
BR2_TARGET_GENERIC_HOSTNAME="GWSYS"
BR2_TARGET_GENERIC_ISSUE="Welcome to GateWay System"
BR2_ROOTFS_DEVICE_CREATION_DYNAMIC_MDEV=y
BR2_ROOTFS_SKELETON_CUSTOM=y
BR2_ROOTFS_SKELETON_CUSTOM_PATH="$(BR2_EXTERNAL)/board/mt7620/skeleton"
BR2_ROOTFS_POST_IMAGE_SCRIPT="$(BR2_EXTERNAL)/board/mt7620/postimage.sh"
BR2_LINUX_KERNEL=y
BR2_LINUX_KERNEL_SAME_AS_HEADERS=y
BR2_LINUX_KERNEL_USE_CUSTOM_CONFIG=y
BR2_LINUX_KERNEL_CUSTOM_CONFIG_FILE="$(BR2_EXTERNAL)/board/mt7620/linux.config"
BR2_LINUX_KERNEL_VMLINUX_BIN=y
BR2_PACKAGE_BUSYBOX_CONFIG="$(BR2_EXTERNAL)/board/mt7620/busybox.config"
BR2_PACKAGE_BUSYBOX_SHOW_OTHERS=y
BR2_PACKAGE_LUA=y
BR2_PACKAGE_CGILUA=y
BR2_PACKAGE_LUA_CJSON=y
BR2_PACKAGE_LUAPOSIX=y
BR2_PACKAGE_LUASOCKET=y
BR2_PACKAGE_WSAPI=y
BR2_PACKAGE_JSON_C=y
BR2_PACKAGE_GMP=y
BR2_PACKAGE_LIBUBOX=y
BR2_PACKAGE_IPROUTE2=y
BR2_PACKAGE_IPTABLES=y
BR2_PACKAGE_IW=y
BR2_PACKAGE_LIGHTTPD=y
BR2_PACKAGE_PPPD=y
BR2_PACKAGE_PPPD_RADIUS=y
BR2_PACKAGE_PPTP_LINUX=y
BR2_PACKAGE_RP_PPPOE=y
BR2_PACKAGE_WIRELESS_TOOLS=y
BR2_PACKAGE_WIRELESS_TOOLS_LIB=y
BR2_PACKAGE_XL2TP=y
BR2_TARGET_ROOTFS_INITRAMFS=y
BR2_PACKAGE_HOST_UBOOT_TOOLS=y
```

## package/ubus/Config.in
```kconfig
config BR2_PACKAGE_UBUS
	bool "ubus"
#	depends on BR2_PACKAGE_LIBUBOX
	help
	  openwrt library ubus
```
